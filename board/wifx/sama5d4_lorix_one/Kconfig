## board/wifx/sama5d4_lorix_one/Kconfig
```kconfig
if TARGET_SAMA5D4_LORIX_ONE

config SYS_BOARD
	default "sama5d4_lorix_one"

config SYS_VENDOR
	default "wifx"
	
config SYS_SOC
	default "at91"

config SYS_CONFIG_NAME
	default "sama5d4_lorix_one"

endif
```

## board/wifx/sama5d4_lorix_one_512/Kconfig
```kconfig
if TARGET_SAMA5D4_LORIX_ONE_512

config SYS_BOARD
	default "sama5d4_lorix_one_512"

config SYS_VENDOR
	default "wifx"
	
config SYS_SOC
	default "at91"

config SYS_CONFIG_NAME
	default "sama5d4_lorix_one_512"

endif
```
